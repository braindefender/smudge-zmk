## Kconfig.defconfig
```kconfig
if SHIELD_SMUDGE_RIGHT

config ZMK_KEYBOARD_NAME
    default "Smudge R"

config ZMK_SPLIT_ROLE_CENTRAL
    default y

endif

if SHIELD_SMUDGE_LEFT || SHIELD_SMUDGE_RIGHT

config ZMK_SPLIT
    default y

endif
```

## Kconfig.shield
```kconfig
config SHIELD_SMUDGE_LEFT
    def_bool $(shields_list_contains,smudge_left)

config SHIELD_SMUDGE_RIGHT
    def_bool $(shields_list_contains,smudge_right)
```
